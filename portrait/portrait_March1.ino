#include <Adafruit_NeoPixel.h>
#ifdef __AVR__
#include <avr/power.h>
#endif

#define PIN 4
#define TOTAL 156
#define sensorRight 7
#define sensorLeft A0

Adafruit_NeoPixel strip = Adafruit_NeoPixel(TOTAL, PIN, NEO_GRB + NEO_KHZ800);

void setup() {
//long js1[154] = {149148144, 163159156, 152150151, 249238234, 249240235, 168167163, 190187180, 178177173, 192187184, 115108100, 107102096, 78072074, 63054059,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 51057073, 39037048};

  Serial.begin(9600);

  pinMode(sensorRight, INPUT);
  pinMode(sensorLeft, INPUT);

  strip.begin(); // start strip
  strip.show(); 

  // set placeholder color
  for(int i=0; i< TOTAL; i++){
    strip.setPixelColor(i, 40,50, 100);
  }
  
  strip.show(); 
  delay(5000);
  
}

void loop() {
  long js2[154] = {236241245, 235240244, 150159176, 70079094, 69078093, 59072089, 88105123, 73088107, 78106084, 34044043, 95121084, 153168201, 140153185,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 194201227, 182194220};
   
  int sensorValueRight = digitalRead(sensorRight);
  int sensorValueLeft = analogRead(sensorLeft);
  Serial.println(sensorValueRight);
  Serial.println(sensorValueLeft);
  Serial.println();

  if(sensorValueRight == 1 || sensorValueLeft > 270){
    Serial.println("here");
     for(int i=0; i< TOTAL; i++){
        long tmp = js2[i];

        // separate r, g, and b values
        long r = tmp/1000000;
        long g = tmp%1000000/1000;
        long b = tmp%1000;
        int rr = (int)r;
        int gg = (int)g;
        int bb = (int)b;

        //determine the correct NeoPixel
        int pos = i/14;
        int j = 0;
        if(pos % 2 == 1){
          j = (13 + 14*pos) - i%14;
         }else{
          j = i;
          }
      
       strip.setPixelColor(j, rr, gg, bb);

    }
  }else{
     for(int i=0; i< TOTAL; i++){
       strip.setPixelColor(i, 40,50, 100);
     }
  }
   strip.show();
   delay(5000);


}



